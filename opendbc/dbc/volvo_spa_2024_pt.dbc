VERSION ""

NS_ :

BS_:

BU_: ECM XXX

BO_ 37 ECM_1: 8 ECM
 SG_ ACCELERATOR_PEDAL_POS : 6|15@0+ (0.00390625,0) [0|127.996] "%" XXX

CM_ "Volvo SPA propulsion CAN (Volvo wiring name: Front CAN 1 / Propulsion CAN). Signals are taken from the reverse engineering in StarPilotHQ/StarPilot volvo_front_1_spa.dbc (S60 Recharge 2024). Nothing here has been verified on an XC90.";
